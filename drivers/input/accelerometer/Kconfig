## drivers/input/accelerometer/Kconfig
```kconfig
#
# accelerometer driver configuration
#
menuconfig HUAWEI_FEATURE_INPUT_ACCELEROMETER
	bool "Accelerometer"
	depends on HUAWEI_KERNEL = y
	default n 
	help
	  Say Y here, and a list of supported ACCELEROMETERs will be displayed.
	  This option doesn't affect the kernel.

	 

if HUAWEI_FEATURE_INPUT_ACCELEROMETER

config HUAWEI_FEATURE_ACCELEROMETER_ADXL345
	tristate "ADI ADXL345 accelerometer"	
	select SERIO
	depends on HUAWEI_KERNEL = y
	default n 
	help
	  Say Y here if you have the ADXL345 accelerometer.

	  
config HUAWEI_FEATURE_ACCELEROMETER_ST_L1S35DE
	tristate "ST LIS35DE accelerometer"	
	select SERIO
	depends on HUAWEI_KERNEL = y
	default n 
	help
	  Say Y here if you have the ST LIS35DE accelerometer.
endif
```

## drivers/media/video/msm/Kconfig
```kconfig
comment "Camera Sensor Selection"
config MT9T013
	bool "Sensor mt9t013 (BAYER 3M)"
	depends on MSM_CAMERA && !ARCH_MSM8X60
	default y
	---help---
	  MICRON 3M Bayer Sensor with AutoFocus

config MT9D112
	bool "Sensor mt9d112 (YUV 2M)"
	depends on MSM_CAMERA && !ARCH_MSM8X60
	default y
	---help---
	  MICRON 2M YUV Sensor
config  HUAWEI_CAMERA
	bool "Select huawei camera"
	depends on MSM_CAMERA
	depends on HUAWEI_KERNEL
	default y
	---help---
	  Select huawei camera

config HUAWEI_SENSOR_OV7690
	bool "Sensor ov7690 (YUV 30K)"
	depends on HUAWEI_CAMERA
	default y
	---help---
	  MICRON 30k YUV Sensor

config HUAWEI_SENSOR_HIMAX0356
	bool "Sensor himax (YUV 30W)"
	depends on HUAWEI_CAMERA
	default y
	---help---
	  HIMAX 30w YUV Sensor

config HUAWEI_SENSOR_S5K4E1GX
	bool "Sensor s5k4e1gx (BAYER 5M)"
	depends on HUAWEI_CAMERA
	default y
	---help---
	  MICRON 5M Bayer Sensor with AutoFocus
config HUAWEI_SENSOR_OV5647_SUNNY
	bool "Sensor ov5647_sunny (BAYER 5M)"
	depends on HUAWEI_CAMERA
	default y
	---help---
	  MICRON 5M Bayer Sensor with AutoFocus
config HUAWEI_FEATURE_RIGHT_TPA2028D1_AMPLIFIER
	tristate "right tpa2028d1 amplifier"
	depends on HUAWEI_KERNEL
	default y
	---help---
	  tpa2028d1 amplifier used for audio.
config IMX074
	bool "Sensor IMX074 (BAYER 13.5M)"
	depends on MSM_CAMERA && ARCH_MSM8X60
	default y
	---help---
	SONY 13.5 MP Bayer Sensor
config VX6953
	bool "Sensor VX6953 (BAYER 5M)"
	depends on MSM_CAMERA && ARCH_MSM7X30
	default y
	---help---
	STM 5M Bayer Sensor with EDOF
config SN12M0PZ
	bool "Sensor sn12m0pz (Bayer 12 MP)"
	depends on MSM_CAMERA && ARCH_MSM7X30
	default y
	---help---
	  Sony 12 MP Bayer Sensor
config MT9P012
	bool "Sensor mt9p012 (BAYER 5M)"
	depends on MSM_CAMERA && !ARCH_MSM8X60
	default y
	---help---
	  MICRON 5M Bayer Sensor with Autofocus

choice
	prompt "AF module"
	depends on MT9P012 && !ARCH_MSM8X60
	default MSM_CAMERA_AF_FOXCONN

config MSM_CAMERA_AF_FOXCONN
	bool "FOXCONN Module"
	help
	  This driver supports FOXCONN AF module for 5M Bayer sensor

config MSM_CAMERA_AF_BAM
	bool "BAM Module"
	help
	  This driver supports BAM AF module for 5M Bayer sensor

endchoice

config MT9P012_KM
	bool "Sensor mt9p012 KM module (BAYER 5M)"
	depends on MSM_CAMERA && !ARCH_MSM8X60
	default y
	---help---
	  MICRON 5M Bayer Sensor KM modules with Autofocus

config S5K3E2FX
	bool "Sensor s5k3e2fx (Samsung 5M)"
	depends on MSM_CAMERA && !ARCH_MSM8X60
	default y
	---help---
	  Samsung 5M with Autofocus

config VB6801
	bool "Sensor vb6801"
	depends on MSM_CAMERA && !ARCH_MSM8X60
	---help---
	  5M with flash

config MSM_CAMERA_FLASH
	bool "Qualcomm MSM camera flash support"
	depends on MSM_CAMERA && !ARCH_MSM8X60
	default y
	---help---
	  Enable support for LED flash for msm camera

config MSM_GEMINI
	tristate "Qualcomm MSM Gemini Jpeg Engine support"
	depends on MSM_CAMERA
	default M
	---help---
	  Enable support for Gemini Jpeg Engine
```
